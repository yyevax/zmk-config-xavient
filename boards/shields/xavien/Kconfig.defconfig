## boards/shields/xavien/Kconfig.defconfig
```kconfig
# Copyright (c) 2020 The ZMK Contributors
# SPDX-License-Identifier: MIT

if SHIELD_XAVIEN_DONGLE || SHIELD_XAVIEN_DONGLE_XIAO || SHIELD_XAVIEN_LEFT_MASTER || SHIELD_XAVIEN_RIGHT_MASTER

config ZMK_KEYBOARD_NAME
	default "XAVIEN"
	
config ZMK_SPLIT_BLE_ROLE_CENTRAL
	default y
	
config ZMK_USB
	default y

endif

if SHIELD_XAVIEN_LEFT || SHIELD_XAVIEN_RIGHT || SHIELD_XAVIEN_DONGLE || SHIELD_XAVIEN_DONGLE_XIAO || SHIELD_XAVIEN_LEFT_MASTER || SHIELD_XAVIEN_RIGHT_MASTER

config ZMK_SPLIT
	default y

config ZMK_POINTING
	default y

config ZMK_BLE
	default y

if ZMK_DISPLAY

config ZMK_DISPLAY
    select LV_USE_CONT
    select LV_FONT_MONTSERRAT_26
    select LV_FONT_MONTSERRAT_16
    select LV_USE_LABEL
    select LV_USE_IMG

config I2C
	default y

config SSD1306
	default y

config SSD1306_REVERSE_MODE
    bool
	default n

endif # ZMK_DISPLAY

if LVGL

config LV_Z_VDB_SIZE
    default 64

config LV_DPI_DEF
    int
    default 148

config LV_Z_BITS_PER_PIXEL
    default 1

choice LV_COLOR_DEPTH
    default LV_COLOR_DEPTH_1
endchoice

endif # LVGL

endif

if SHIELD_XAVIEN_LEFT || SHIELD_XAVIEN_RIGHT || SHIELD_XAVIEN_LEFT_MASTER || SHIELD_XAVIEN_RIGHT_MASTER

config ZMK_RGB_UNDERGLOW
    bool "Enable RGB Underglow"
    default y

config ZMK_RGB_UNDERGLOW_BRT_START
    int "Starting Brightness (0-100)"
    default 30

config ZMK_RGB_UNDERGLOW_HUE_START
    int "Starting Hue (0-360)"
    default 75

config ZMK_RGB_UNDERGLOW_SAT_START
    int "Starting Saturation (0-100)"
    default 100

endif
```

## config/west.yml
```yaml
manifest:
  remotes:
    - name: upstream
      url-base: https://github.com/zmkfirmware
    - name: zmkfirmware
      url-base: https://github.com/zmkfirmware
    - name: caksoylar
      url-base: https://github.com/caksoylar
    - name: urob
      url-base: https://github.com/urob
    - name: duanexavierbondad
      url-base: https://github.com/duanexavierbondad
    - name: dhruvinsh
      url-base: https://github.com/dhruvinsh
    - name: m165437
      url-base: https://github.com/M165437
    - name: yyevax
      url-base: https://github.com/yyevax
    - name: badjeff
      url-base: https://github.com/badjeff
  projects:
    - name: zmk
      remote: zmkfirmware
      revision: main
      import: app/west.yml
    - name: zmk-rgbled-widget
      remote: caksoylar
      revision: main
    - name: zmk-tri-state
      remote: dhruvinsh
      revision: main
    - name: zmk-helpers
      remote: urob
      revision: main
    - name: nice-view-config
      remote: yyevax
      revision: peripheral-slideshow
    - name: kb_zmk_ps2_mouse_trackpoint_driver
      remote: badjeff
      revision: 2df4d6d0d305ed121b1efbf0a028b44b174dccc7
  self:
    path: config
```
