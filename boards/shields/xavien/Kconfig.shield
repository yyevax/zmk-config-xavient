## boards/shields/xavien/Kconfig.shield
```kconfig
# Copyright (c) 2020 The ZMK Contributors
# SPDX-License-Identifier: MIT

config SHIELD_XAVIEN_LEFT
	def_bool $(shields_list_contains,xavien_left)

config SHIELD_XAVIEN_RIGHT
	def_bool $(shields_list_contains,xavien_right)

config SHIELD_XAVIEN_DONGLE
	def_bool $(shields_list_contains,xavien_dongle)

config SHIELD_XAVIEN_DONGLE_XIAO
	def_bool $(shields_list_contains,xavien_dongle_xiao)

config SHIELD_XAVIEN_LEFT_MASTER
	def_bool $(shields_list_contains,xavien_left_master)

config SHIELD_XAVIEN_RIGHT_MASTER
	def_bool $(shields_list_contains,xavien_right_master)
```
